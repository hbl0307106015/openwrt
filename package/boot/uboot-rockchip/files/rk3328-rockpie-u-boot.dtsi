// SPDX-License-Identifier: GPL-2.0+
/*
 * (C) Copyright 2020 Radxa
 */

#include "rk3328-u-boot.dtsi"
#include "rk3328-sdram-ddr3-666.dtsi"

/ {
	chosen {
		u-boot,spl-boot-order = "same-as-spl", &sdmmc, &emmc;
	};
};

&usb_host0_xhci {
	vbus-supply = <&vcc5v0_host_xhci>;
	status = "okay";
};
